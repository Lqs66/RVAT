/* Linker script for fixing .global_vars section at 0x4000000 */

SECTIONS
{
  .global_vars 0x4000000 : {
    KEEP(*(global_vars.0))
    KEEP(*(global_vars.1))
    KEEP(*(global_vars.2))
    KEEP(*(global_vars.3))
    KEEP(*(global_vars.4))
    KEEP(*(global_vars.5))
    KEEP(*(global_vars.6))
    KEEP(*(global_vars.7))
    KEEP(*(global_vars.8))
    KEEP(*(global_vars.9))
    KEEP(*(global_vars.10))
    KEEP(*(global_vars.11))
    KEEP(*(global_vars.12))
    KEEP(*(global_vars.13))
    KEEP(*(global_vars.14))
    KEEP(*(global_vars.15))
    KEEP(*(global_vars.16))
    KEEP(*(global_vars.17))
    KEEP(*(global_vars.18))
    KEEP(*(global_vars.19))
    KEEP(*(global_vars.20))
    KEEP(*(global_vars.21))
    KEEP(*(global_vars.22))
    KEEP(*(global_vars.23))
    KEEP(*(global_vars.24))
    KEEP(*(global_vars.25))
    KEEP(*(global_vars.26))
    KEEP(*(global_vars.27))
    KEEP(*(global_vars.28))
    KEEP(*(global_vars.29))
    KEEP(*(global_vars.30))
    KEEP(*(global_vars.31))
    KEEP(*(global_vars.32))
    KEEP(*(global_vars.33))
    KEEP(*(global_vars.34))
    KEEP(*(global_vars.35))
    KEEP(*(global_vars.36))
    KEEP(*(global_vars.37))
    KEEP(*(global_vars.38))
    KEEP(*(global_vars.39))
    KEEP(*(global_vars.40))
    KEEP(*(global_vars.41))
    KEEP(*(global_vars.42))
    KEEP(*(global_vars.43))
    KEEP(*(global_vars.44))
    KEEP(*(global_vars.45))
    KEEP(*(global_vars.46))
    KEEP(*(global_vars.47))
    KEEP(*(global_vars.48))
    KEEP(*(global_vars.49))
    KEEP(*(global_vars.50))
    KEEP(*(global_vars.51))
    KEEP(*(global_vars.52))
    KEEP(*(global_vars.53))
    KEEP(*(global_vars.54))
    KEEP(*(global_vars.55))
    KEEP(*(global_vars.56))
    KEEP(*(global_vars.57))
    KEEP(*(global_vars.58))
    KEEP(*(global_vars.59))
    KEEP(*(global_vars.60))
    KEEP(*(global_vars.61))
    KEEP(*(global_vars.62))
    KEEP(*(global_vars.63))
    KEEP(*(global_vars.64))
    KEEP(*(global_vars.65))
    KEEP(*(global_vars.66))
    KEEP(*(global_vars.67))
    KEEP(*(global_vars.68))
    KEEP(*(global_vars.69))
    KEEP(*(global_vars.70))
    KEEP(*(global_vars.71))
    KEEP(*(global_vars.72))
    KEEP(*(global_vars.73))
    KEEP(*(global_vars.74))
    KEEP(*(global_vars.75))
    KEEP(*(global_vars.76))
    KEEP(*(global_vars.77))
    KEEP(*(global_vars.78))
    KEEP(*(global_vars.79))
    KEEP(*(global_vars.80))
    KEEP(*(global_vars.81))
    KEEP(*(global_vars.82))
    KEEP(*(global_vars.83))
    KEEP(*(global_vars.84))
    KEEP(*(global_vars.85))
    KEEP(*(global_vars.86))
    KEEP(*(global_vars.87))
    KEEP(*(global_vars.88))
    KEEP(*(global_vars.89))
    KEEP(*(global_vars.90))
    KEEP(*(global_vars.91))
    KEEP(*(global_vars.92))
    KEEP(*(global_vars.93))
    KEEP(*(global_vars.94))
    KEEP(*(global_vars.95))
    KEEP(*(global_vars.96))
    KEEP(*(global_vars.97))
    KEEP(*(global_vars.98))
    KEEP(*(global_vars.99))
    KEEP(*(global_vars.100))
    KEEP(*(global_vars.101))
    KEEP(*(global_vars.102))
    KEEP(*(global_vars.103))
    KEEP(*(global_vars.104))
    KEEP(*(global_vars.105))
    KEEP(*(global_vars.106))
    KEEP(*(global_vars.107))
    KEEP(*(global_vars.108))
    KEEP(*(global_vars.109))
    KEEP(*(global_vars.110))
    KEEP(*(global_vars.111))
    KEEP(*(global_vars.112))
    KEEP(*(global_vars.113))
    KEEP(*(global_vars.114))
    KEEP(*(global_vars.115))
    KEEP(*(global_vars.116))
    KEEP(*(global_vars.117))
    KEEP(*(global_vars.118))
    KEEP(*(global_vars.119))
    KEEP(*(global_vars.120))
    KEEP(*(global_vars.121))
    KEEP(*(global_vars.122))
    KEEP(*(global_vars.123))
    KEEP(*(global_vars.124))
    KEEP(*(global_vars.125))
    KEEP(*(global_vars.126))
    KEEP(*(global_vars.127))
    KEEP(*(global_vars.128))
    KEEP(*(global_vars.129))
    KEEP(*(global_vars.130))
    KEEP(*(global_vars.131))
    KEEP(*(global_vars.132))
    KEEP(*(global_vars.133))
    KEEP(*(global_vars.134))
    KEEP(*(global_vars.135))
    KEEP(*(global_vars.136))
    KEEP(*(global_vars.137))
    KEEP(*(global_vars.138))
    KEEP(*(global_vars.139))
    KEEP(*(global_vars.140))
    KEEP(*(global_vars.141))
    KEEP(*(global_vars.142))
    KEEP(*(global_vars.143))
    KEEP(*(global_vars.144))
    KEEP(*(global_vars.145))
    KEEP(*(global_vars.146))
    KEEP(*(global_vars.147))
    KEEP(*(global_vars.148))
    KEEP(*(global_vars.149))
    KEEP(*(global_vars.150))
    KEEP(*(global_vars.151))
    KEEP(*(global_vars.152))
    KEEP(*(global_vars.153))
    KEEP(*(global_vars.154))
    KEEP(*(global_vars.155))
    KEEP(*(global_vars.156))
    KEEP(*(global_vars.157))
    KEEP(*(global_vars.158))
    KEEP(*(global_vars.159))
    KEEP(*(global_vars.160))
    KEEP(*(global_vars.161))
    KEEP(*(global_vars.162))
    KEEP(*(global_vars.163))
    KEEP(*(global_vars.164))
    KEEP(*(global_vars.165))
    KEEP(*(global_vars.166))
    KEEP(*(global_vars.167))
    KEEP(*(global_vars.168))
    KEEP(*(global_vars.169))
    KEEP(*(global_vars.170))
    KEEP(*(global_vars.171))
    KEEP(*(global_vars.172))
    KEEP(*(global_vars.173))
    KEEP(*(global_vars.174))
    KEEP(*(global_vars.175))
    KEEP(*(global_vars.176))
    KEEP(*(global_vars.177))
    KEEP(*(global_vars.178))
    KEEP(*(global_vars.179))
    KEEP(*(global_vars.180))
    KEEP(*(global_vars.181))
    KEEP(*(global_vars.182))
    KEEP(*(global_vars.183))
    KEEP(*(global_vars.184))
    KEEP(*(global_vars.185))
    KEEP(*(global_vars.186))
    KEEP(*(global_vars.187))
    KEEP(*(global_vars.188))
    KEEP(*(global_vars.189))
    KEEP(*(global_vars.190))
    KEEP(*(global_vars.191))
    KEEP(*(global_vars.192))
    KEEP(*(global_vars.193))
    KEEP(*(global_vars.194))
    KEEP(*(global_vars.195))
    KEEP(*(global_vars.196))
    KEEP(*(global_vars.197))
    KEEP(*(global_vars.198))
    KEEP(*(global_vars.199))
    KEEP(*(global_vars.200))
    KEEP(*(global_vars.201))
    KEEP(*(global_vars.202))
    KEEP(*(global_vars.203))
    KEEP(*(global_vars.204))
    KEEP(*(global_vars.205))
    KEEP(*(global_vars.206))
    KEEP(*(global_vars.207))
    KEEP(*(global_vars.208))
    KEEP(*(global_vars.209))
    KEEP(*(global_vars.210))
    KEEP(*(global_vars.211))
    KEEP(*(global_vars.212))
    KEEP(*(global_vars.213))
    KEEP(*(global_vars.214))
    KEEP(*(global_vars.215))
    KEEP(*(global_vars.216))
    KEEP(*(global_vars.217))
    KEEP(*(global_vars.218))
    KEEP(*(global_vars.219))
    KEEP(*(global_vars.220))
    KEEP(*(global_vars.221))
    KEEP(*(global_vars.222))
    KEEP(*(global_vars.223))
    KEEP(*(global_vars.224))
    KEEP(*(global_vars.225))
    KEEP(*(global_vars.226))
    KEEP(*(global_vars.227))
    KEEP(*(global_vars.228))
    KEEP(*(global_vars.229))
    KEEP(*(global_vars.230))
    KEEP(*(global_vars.231))
    KEEP(*(global_vars.232))
    KEEP(*(global_vars.233))
    KEEP(*(global_vars.234))
    KEEP(*(global_vars.235))
    KEEP(*(global_vars.236))
    KEEP(*(global_vars.237))
    KEEP(*(global_vars.238))
    KEEP(*(global_vars.239))
    KEEP(*(global_vars.240))
    KEEP(*(global_vars.241))
    KEEP(*(global_vars.242))
    KEEP(*(global_vars.243))
    KEEP(*(global_vars.244))
    KEEP(*(global_vars.245))
    KEEP(*(global_vars.246))
    KEEP(*(global_vars.247))
    KEEP(*(global_vars.248))
    KEEP(*(global_vars.249))
    KEEP(*(global_vars.250))
    KEEP(*(global_vars.251))
    KEEP(*(global_vars.252))
    KEEP(*(global_vars.253))
    KEEP(*(global_vars.254))
    KEEP(*(global_vars.255))
    KEEP(*(global_vars.256))
    KEEP(*(global_vars.257))
    KEEP(*(global_vars.258))
    KEEP(*(global_vars.259))
    KEEP(*(global_vars.260))
    KEEP(*(global_vars.261))
    KEEP(*(global_vars.262))
    KEEP(*(global_vars.263))
    KEEP(*(global_vars.264))
    KEEP(*(global_vars.265))
    KEEP(*(global_vars.266))
    KEEP(*(global_vars.267))
    KEEP(*(global_vars.268))
    KEEP(*(global_vars.269))
    KEEP(*(global_vars.270))
    KEEP(*(global_vars.271))
    KEEP(*(global_vars.272))
    KEEP(*(global_vars.273))
    KEEP(*(global_vars.274))
    KEEP(*(global_vars.275))
    KEEP(*(global_vars.276))
    KEEP(*(global_vars.277))
    KEEP(*(global_vars.278))
    KEEP(*(global_vars.279))
    KEEP(*(global_vars.280))
    KEEP(*(global_vars.281))
    KEEP(*(global_vars.282))
    KEEP(*(global_vars.283))
    KEEP(*(global_vars.284))
    KEEP(*(global_vars.285))
    KEEP(*(global_vars.286))
    KEEP(*(global_vars.287))
    KEEP(*(global_vars.288))
    KEEP(*(global_vars.289))
    KEEP(*(global_vars.290))
    KEEP(*(global_vars.291))
    KEEP(*(global_vars.292))
    KEEP(*(global_vars.293))
    KEEP(*(global_vars.294))
    KEEP(*(global_vars.295))
    KEEP(*(global_vars.296))
    KEEP(*(global_vars.297))
    KEEP(*(global_vars.298))
    KEEP(*(global_vars.299))
    KEEP(*(global_vars.300))
    KEEP(*(global_vars.301))
    KEEP(*(global_vars.302))
    KEEP(*(global_vars.303))
    KEEP(*(global_vars.304))
    KEEP(*(global_vars.305))
    KEEP(*(global_vars.306))
    KEEP(*(global_vars.307))
    KEEP(*(global_vars.308))
    KEEP(*(global_vars.309))
    KEEP(*(global_vars.310))
    KEEP(*(global_vars.311))
    KEEP(*(global_vars.312))
    KEEP(*(global_vars.313))
    KEEP(*(global_vars.314))
    KEEP(*(global_vars.315))
    KEEP(*(global_vars.316))
    KEEP(*(global_vars.317))
    KEEP(*(global_vars.318))
    KEEP(*(global_vars.319))
    KEEP(*(global_vars.320))
    KEEP(*(global_vars.321))
    KEEP(*(global_vars.322))
    KEEP(*(global_vars.323))
    KEEP(*(global_vars.324))
    KEEP(*(global_vars.325))
    KEEP(*(global_vars.326))
    KEEP(*(global_vars.327))
    KEEP(*(global_vars.328))
    KEEP(*(global_vars.329))
    KEEP(*(global_vars.330))
    KEEP(*(global_vars.331))
    KEEP(*(global_vars.332))
    KEEP(*(global_vars.333))
    KEEP(*(global_vars.334))
    KEEP(*(global_vars.335))
    KEEP(*(global_vars.336))
    KEEP(*(global_vars.337))
    KEEP(*(global_vars.338))
    KEEP(*(global_vars.339))
    KEEP(*(global_vars.340))
    KEEP(*(global_vars.341))
    KEEP(*(global_vars.342))
    KEEP(*(global_vars.343))
    KEEP(*(global_vars.344))
    KEEP(*(global_vars.345))
    KEEP(*(global_vars.346))
    KEEP(*(global_vars.347))
    KEEP(*(global_vars.348))
    KEEP(*(global_vars.349))
    KEEP(*(global_vars.350))
    KEEP(*(global_vars.351))
    KEEP(*(global_vars.352))
    KEEP(*(global_vars.353))
    KEEP(*(global_vars.354))
    KEEP(*(global_vars.355))
    KEEP(*(global_vars.356))
    KEEP(*(global_vars.357))
    KEEP(*(global_vars.358))
    KEEP(*(global_vars.359))
    KEEP(*(global_vars.360))
    KEEP(*(global_vars.361))
    KEEP(*(global_vars.362))
    KEEP(*(global_vars.363))
    KEEP(*(global_vars.364))
    KEEP(*(global_vars.365))
    KEEP(*(global_vars.366))
    KEEP(*(global_vars.367))
    KEEP(*(global_vars.368))
    KEEP(*(global_vars.369))
    KEEP(*(global_vars.370))
    KEEP(*(global_vars.371))
    KEEP(*(global_vars.372))
    KEEP(*(global_vars.373))
    KEEP(*(global_vars.374))
    KEEP(*(global_vars.375))
    KEEP(*(global_vars.376))
    KEEP(*(global_vars.377))
    KEEP(*(global_vars.378))
    KEEP(*(global_vars.379))
    KEEP(*(global_vars.380))
    KEEP(*(global_vars.381))
    KEEP(*(global_vars.382))
    KEEP(*(global_vars.383))
    KEEP(*(global_vars.384))
    KEEP(*(global_vars.385))
    KEEP(*(global_vars.386))
    KEEP(*(global_vars.387))
    KEEP(*(global_vars.388))
  }
}

INSERT BEFORE .text;
